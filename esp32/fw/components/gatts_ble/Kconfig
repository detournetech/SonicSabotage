## esp32/fw/components/gatts_ble/Kconfig
```kconfig
config BLE_GATTS_SECURITY
    bool "Enhanced BLE security"
    default "n"
    help
        Use Numeric Comparison instead of Just Works. Limited support.

config NUMERIC_COMPARISON_EZ_DEV
    bool "Unconditional NC confirmation"
    default "n"
    help
        Unconditionally accept Numeric Comparison requests on esp32 (for dev)
```

## esp32/fw/components/wifi_connect/Kconfig
```kconfig
config OTA_CAN_WRITE_FLASH
    bool "Enable OTA partition writes"
    default "y"
    help
        OTA can write fw to flash. Can be disabled for testing
```
